## code/components/esp-nn/Kconfig.projbuild
```kconfig
menu "ESP-NN"

choice NN_OPTIMIZATIONS
   bool "Optimization for nn functions"
   default NN_OPTIMIZED
   help
      Use ANSI-C versions for verification and debug purpose.
      Optimisations are automatically picked up for a chipset.
      For ESP32-S3, assembly Optimisations are selected.
      For ESP32, just the ANSI C versions are selected for now.

config NN_ANSI_C
   bool "ANSI C"
   help
      ANSI C versions for verification and debug purposes.
config NN_OPTIMIZED
   bool "Optimized versions"
   help
      Optimisations are automatically picked up for a chipset.
      For ESP32-S3, assembly Optimisations are selected.
      For ESP32, just the ANSI C versions are selected for now.
endchoice

config NN_OPTIMIZATIONS
   int
   default 0 if NN_ANSI_C
   default 1 if NN_OPTIMIZED

endmenu
```

## code/components/esp-nn/test_app/sdkconfig.defaults.esp32s3
```kconfig
# Default configurations for ESP32-S3

CONFIG_ESP32S3_DEFAULT_CPU_FREQ_240=y
CONFIG_ESP32S3_SPIRAM_SUPPORT=y

CONFIG_ESP32S3_DATA_CACHE_64KB=y
CONFIG_ESP32S3_DATA_CACHE_8WAYS=y
CONFIG_ESP32S3_DATA_CACHE_LINE_64B=y
```

## code/components/esp32-camera-master/Kconfig
```kconfig
menu "Camera configuration"

    config OV7670_SUPPORT
        bool "Support OV7670 VGA"
        default y
        help
            Enable this option if you want to use the OV7670.
            Disable this option to save memory.

    config OV7725_SUPPORT
        bool "Support OV7725 VGA"
        default y
        help
            Enable this option if you want to use the OV7725.
            Disable this option to save memory.

    config NT99141_SUPPORT
        bool "Support NT99141 HD"
        default y
        help
            Enable this option if you want to use the NT99141.
            Disable this option to save memory.

    config OV2640_SUPPORT
        bool "Support OV2640 2MP"
        default y
        help
            Enable this option if you want to use the OV2640.
            Disable this option to save memory.

    config OV3660_SUPPORT
        bool "Support OV3660 3MP"
        default y
        help
            Enable this option if you want to use the OV3360.
            Disable this option to save memory.

    config OV5640_SUPPORT
        bool "Support OV5640 5MP"
        default y
        help
            Enable this option if you want to use the OV5640.
            Disable this option to save memory.

    config GC2145_SUPPORT
        bool "Support GC2145 2MP"
        default y
        help
            Enable this option if you want to use the GC2145.
            Disable this option to save memory.

    config GC032A_SUPPORT
        bool "Support GC032A VGA"
        default y
        help
            Enable this option if you want to use the GC032A.
            Disable this option to save memory.

    config GC0308_SUPPORT
        bool "Support GC0308 VGA"
        default y
        help
            Enable this option if you want to use the GC0308.
            Disable this option to save memory.
            
    config BF3005_SUPPORT
        bool "Support BF3005(BYD3005) VGA"
        default y
        help
            Enable this option if you want to use the BF3005.
            Disable this option to save memory.
            
    config BF20A6_SUPPORT
        bool "Support BF20A6(BYD20A6) VGA"
        default y
        help
            Enable this option if you want to use the BF20A6.
            Disable this option to save memory.

    config SC101IOT_SUPPORT
        bool "Support SC101IOT HD"
        default n
        help
            Enable this option if you want to use the SC101IOT.
            Disable this option to save memory.

    choice SC101_REGS_SELECT
        prompt "SC101iot default regs"
        default SC101IOT_720P_15FPS_ENABLED
        depends on SC101IOT_SUPPORT
        help
            Currently SC010iot has several register sets available.
            Select the one that matches your needs.

        config SC101IOT_720P_15FPS_ENABLED
            bool "xclk20M_720p_15fps"
        help
            Select this option means that when xclk is 20M, the frame rate is 15fps at 720p resolution.
        config SC101IOT_VGA_25FPS_ENABLED
            bool "xclk20M_VGA_25fps"
        help
            Select this option means that when xclk is 20M, the frame rate is 25fps at VGA resolution.
    endchoice

    config SC030IOT_SUPPORT
        bool "Support SC030IOT VGA"
        default y
        help
            Enable this option if you want to use the SC030IOT.
            Disable this option to save memory.

    choice SCCB_HARDWARE_I2C_PORT
        bool "I2C peripheral to use for SCCB"
        default SCCB_HARDWARE_I2C_PORT1

        config SCCB_HARDWARE_I2C_PORT0
            bool "I2C0"
        config SCCB_HARDWARE_I2C_PORT1
            bool "I2C1"

    endchoice

    config SCCB_CLK_FREQ
    int "SCCB clk frequency"
    default 100000
    range 100000 400000
    help
        Increasing this value can reduce the initialization time of the sensor.
        Please refer to the relevant instructions of the sensor to adjust the value.
    
    choice GC_SENSOR_WINDOW_MODE
        bool "GalaxyCore Sensor Window Mode"
        depends on (GC2145_SUPPORT || GC032A_SUPPORT || GC0308_SUPPORT)
        default GC_SENSOR_SUBSAMPLE_MODE
        help
            This option determines how to reduce the output size when the resolution you set is less than the maximum resolution.
            SUBSAMPLE_MODE has a bigger perspective and WINDOWING_MODE has a higher frame rate.

        config GC_SENSOR_WINDOWING_MODE
            bool "Windowing Mode"
        config GC_SENSOR_SUBSAMPLE_MODE
            bool "Subsample Mode"
    endchoice

    choice CAMERA_TASK_PINNED_TO_CORE
        bool "Camera task pinned to core"
        default CAMERA_CORE0
        help
            Pin the camera handle task to a certain core(0/1). It can also be done automatically choosing NO_AFFINITY.

        config CAMERA_CORE0
            bool "CORE0"
        config CAMERA_CORE1
            bool "CORE1"
        config CAMERA_NO_AFFINITY
            bool "NO_AFFINITY"

    endchoice

    config CAMERA_DMA_BUFFER_SIZE_MAX
        int "DMA buffer size"
        range 8192 32768
        default 32768
        help
            Maximum value of DMA buffer
            Larger values may fail to allocate due to insufficient contiguous memory blocks, and smaller value may cause DMA interrupt to be too frequent
    
    config CAMERA_CONVERTER_ENABLED
        bool "Enable camera RGB/YUV converter"
        depends on IDF_TARGET_ESP32S3
        default n
        help
            Enable this option if you want to use RGB565/YUV422/YUV420/YUV411 format conversion.

    choice CAMERA_CONV_PROTOCOL
        bool "Camera converter protocol"
        depends on CAMERA_CONVERTER_ENABLED
        default LCD_CAM_CONV_BT601_ENABLED
        help
            Supports format conversion under both BT601 and BT709 standards.

        config LCD_CAM_CONV_BT601_ENABLED
            bool "BT601"
        config LCD_CAM_CONV_BT709_ENABLED
            bool "BT709"
    endchoice
endmenu
```

## code/components/mdns/Kconfig
```kconfig
menu "mDNS"

    config MDNS_MAX_INTERFACES
        int "Max number of interfaces"
        range 1 9
        default 3
        help
            Number of network interfaces to be served by the mDNS library.
            Lowering this number helps to reduce some static RAM usage.

    config MDNS_MAX_SERVICES
        int "Max number of services"
        default 10
        help
            Services take up a certain amount of memory, and allowing fewer
            services to be open at the same time conserves memory. Specify
            the maximum amount of services here.

    config MDNS_TASK_PRIORITY
        int "mDNS task priority"
        range 1 255
        default 1
        help
            Allows setting mDNS task priority. Please do not set the task priority
            higher than priorities of system tasks. Compile time warning/error
            would be emitted if the chosen task priority were too high.

    config MDNS_ACTION_QUEUE_LEN
        int "Maximum actions pending to the server"
        range 8 64
        default 16
        help
            Allows setting the length of mDNS action queue.

    config MDNS_TASK_STACK_SIZE
        int "mDNS task stack size"
        default 4096
        help
            Allows setting mDNS task stacksize.

    choice MDNS_TASK_AFFINITY
        prompt "mDNS task affinity"
        default MDNS_TASK_AFFINITY_CPU0
        help
            Allows setting mDNS tasks affinity, i.e. whether the task is pinned to
            CPU0, pinned to CPU1, or allowed to run on any CPU.

        config MDNS_TASK_AFFINITY_NO_AFFINITY
            bool "No affinity"
        config MDNS_TASK_AFFINITY_CPU0
            bool "CPU0"
        config MDNS_TASK_AFFINITY_CPU1
            bool "CPU1"
            depends on !FREERTOS_UNICORE

    endchoice

    config MDNS_TASK_AFFINITY
        hex
        default FREERTOS_NO_AFFINITY if MDNS_TASK_AFFINITY_NO_AFFINITY
        default 0x0 if MDNS_TASK_AFFINITY_CPU0
        default 0x1 if MDNS_TASK_AFFINITY_CPU1

    menu "MDNS Memory Configuration"

        choice MDNS_TASK_MEMORY_ALLOC_FROM
            prompt "Select mDNS task create on which type of memory"
            default MDNS_TASK_CREATE_FROM_INTERNAL
            config MDNS_TASK_CREATE_FROM_SPIRAM
                bool "mDNS task creates on the SPIRAM (READ HELP)"
                depends on (SPIRAM_USE_CAPS_ALLOC || SPIRAM_USE_MALLOC)
                help
                    mDNS task creates on the SPIRAM.
                    This option requires FreeRTOS component to allow creating
                    tasks on the external memory.
                    Please read the documentation about FREERTOS_TASK_CREATE_ALLOW_EXT_MEM

            config MDNS_TASK_CREATE_FROM_INTERNAL
                bool "mDNS task creates on the internal RAM"

        endchoice

        choice MDNS_MEMORY_ALLOC_FROM
            prompt "Select mDNS memory allocation type"
            default MDNS_MEMORY_ALLOC_INTERNAL

            config MDNS_MEMORY_ALLOC_SPIRAM
                bool "Allocate mDNS memory from SPIRAM"
                depends on (SPIRAM_USE_CAPS_ALLOC || SPIRAM_USE_MALLOC)

            config MDNS_MEMORY_ALLOC_INTERNAL
                bool "Allocate mDNS memory from internal RAM"

        endchoice

        config MDNS_MEMORY_CUSTOM_IMPL
            bool "Implement custom memory functions"
            default n
            help
                Enable to implement custom memory functions for mDNS library.
                This option is useful when the application wants to use custom
                memory allocation functions for mDNS library.

    endmenu # MDNS Memory Configuration

    config MDNS_SERVICE_ADD_TIMEOUT_MS
        int "mDNS adding service timeout (ms)"
        range 10 30000
        default 2000
        help
            Configures timeout for adding a new mDNS service. Adding a service
            fails if could not be completed within this time.

    config MDNS_TIMER_PERIOD_MS
        int "mDNS timer period (ms)"
        range 10 10000
        default 100
        help
            Configures period of mDNS timer, which periodically transmits packets
            and schedules mDNS searches.

    config MDNS_NETWORKING_SOCKET
        bool "Use BSD sockets for mDNS networking"
        default n
        help
            Enables optional mDNS networking implementation using BSD sockets
            in UDP multicast mode.
            This option creates a new thread to serve receiving packets (TODO).
            This option uses additional N sockets, where N is number of interfaces.

    config MDNS_SKIP_SUPPRESSING_OWN_QUERIES
        bool "Skip suppressing our own packets"
        default n
        help
            Enable only if the querier and the responder share the same IP address.
            This usually happens in test mode, where we may run multiple instances of
            responders/queriers on the same interface.

    config MDNS_ENABLE_DEBUG_PRINTS
        bool "Enable debug prints of mDNS packets"
        default n
        help
            Enable for the library to log received and sent mDNS packets to stdout.

    config MDNS_ENABLE_CONSOLE_CLI
        bool "Enable Command Line Interface on device console"
        default y
        help
            Enable for the console cli to be available on the device.

    config MDNS_RESPOND_REVERSE_QUERIES
        bool "Enable responding to IPv4 reverse queries"
        default n
        help
            Enables support for IPv4 reverse lookup. If enabled, the mDNS library
            response to PTR queries of "A.B.C.D.in-addr.arpa" type.

    config MDNS_MULTIPLE_INSTANCE
        bool "Multiple instances under the same service type"
        default y
        help
            Enables adding multiple service instances under the same service type.

    menu "MDNS Predefined interfaces"

        config MDNS_PREDEF_NETIF_STA
            bool "Use predefined interface for WiFi Station"
            default y
            help
                Set up mDNS for the default WiFi station.
                Disable this option if you do not need mDNS on default WiFi STA.

        config MDNS_PREDEF_NETIF_AP
            bool "Use predefined interface for WiFi Access Point"
            default y
            help
                Set up mDNS for the default WiFi Access Point.
                Disable this option if you do not need mDNS on default WiFi AP.

        config MDNS_PREDEF_NETIF_ETH
            bool "Use predefined interface for Ethernet"
            depends on ETH_ENABLED
            default y
            help
                Set up mDNS for the default Ethernet interface.
                Disable this option if you do not need mDNS on default Ethernet.

    endmenu # MDNS Predefined interfaces

endmenu
```

## code/components/mdns/tests/host_test/components/esp_netif_linux/Kconfig
```kconfig
menu "LWIP-MOCK-CONFIG"

    config LWIP_IPV6
        bool "Enable IPv6"
        default y
        help
            Enable/disable IPv6

    config LWIP_IPV4
        bool "Enable IPv4"
        default y
        help
            Enable/disable IPv4

endmenu
```

## code/components/mdns/tests/host_test/main/Kconfig.projbuild
```kconfig
menu "Test Configuration"

    config TEST_HOSTNAME
        string "mDNS Hostname"
        default "esp32-mdns"
        help
            mDNS Hostname for example to use

    config TEST_NETIF_NAME
        string "Network interface name"
        default "eth2"
        help
            Name/ID if the network interface on which we run the mDNS host test

    config TEST_CONSOLE
        bool "Start console"
        default n
        help
            Test uses esp_console for interactive testing.

endmenu
```

## code/components/mdns/tests/host_test/sdkconfig.defaults
```kconfig
CONFIG_TEST_NETIF_NAME="eth0"
CONFIG_ESP_EVENT_POST_FROM_ISR=n
CONFIG_MDNS_NETWORKING_SOCKET=y
CONFIG_MDNS_SKIP_SUPPRESSING_OWN_QUERIES=y
CONFIG_MDNS_PREDEF_NETIF_STA=n
CONFIG_MDNS_PREDEF_NETIF_AP=n
```
